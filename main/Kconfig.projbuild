## main/Kconfig.projbuild
```kconfig
menu "Example Configuration"

    config LLM_USE_DISPLAY
        bool "Enable SSD1306 OLED display output"
        default y
        help
            Show generation progress and tok/s on an SSD1306 display over
            I2C. Disable when no display is attached, otherwise the u8g2
            HAL asserts on the failed I2C transaction.

    config LLM_FIXED_SEED
        int "Fixed RNG seed (0 = seed from time)"
        default 0
        help
            Seed for the sampler RNG. A non-zero value makes generation
            deterministic, which lets CI compare the generated text across
            runs to detect numerical changes.

    config LLM_GENERATE_LOOP
        bool "Generate in an endless loop"
        default n
        help
            Restart generation after each completion instead of stopping.
            Used by the CI benchmark to take several measurements without
            resetting the chip.

    config LLM_EVAL
        bool "Correctness eval mode (teacher-forced perplexity)"
        default n
        help
            Instead of generating a story, run the correctness eval: compute
            teacher-forced perplexity over a fixed reference sentence and
            print "perplexity: <float>". CI compares this against the golden
            value in eval/golden.json to catch code changes that corrupt the
            model numerics (e.g. a fast-but-wrong SIMD/alignment change).

    config LLM_INTERACTIVE
        bool "Interactive prompt mode (read prompts from the console)"
        default n
        help
            Instead of generating from a fixed empty prompt, wait for a line
            of text on the console and continue it. Each prompt starts a new
            generation, so the output varies with what you type. Keep this
            off for the CI benchmark/eval builds, which expect the automated
            generate loop. Ignored when LLM_EVAL is set.

    config LLM_TEMPERATURE_X10
        int "Sampling temperature x10 (10 = 1.0)"
        default 10
        range 0 20
        help
            Sampling temperature multiplied by 10 (Kconfig has no float type).
            0 = greedy/deterministic, 10 = 1.0 (original), higher flattens the
            distribution for more varied but less coherent text. Most useful
            with LLM_INTERACTIVE to dial in how adventurous the model is.

    menu "I2C Master"
        config I2C_MASTER_SCL
            int "SCL GPIO Num"
            default 9
            help
                GPIO number for I2C Master clock line.

        config I2C_MASTER_SDA
            int "SDA GPIO Num"
            default 8
            help
                GPIO number for I2C Master data line.

        config I2C_MASTER_FREQUENCY
            int "Master Frequency"
            default 400000
            help
                I2C Speed of Master device.
    endmenu

endmenu
```
